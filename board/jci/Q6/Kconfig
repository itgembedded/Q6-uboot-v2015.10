## board/jci/Q6/Kconfig
```kconfig
if TARGET_Q6

config SYS_BOARD
	default "Q6"

config SYS_VENDOR
	default "jci"

config SYS_CONFIG_NAME
	default "Q6"

endif
```

## configs/Q6_defconfig
```kconfig
CONFIG_ARM=y
CONFIG_ARCH_MX6=y
CONFIG_TARGET_Q6=y
# CONFIG_SYS_EXTRA_OPTIONS="IMX_CONFIG=board/jci/Q6/mx6q_4x_mt41j128.cfg,MX6Q"
CONFIG_SYS_EXTRA_OPTIONS="IMX_CONFIG=board/jci/Q6/mx6q_4x_mt41j256.cfg,MX6Q,DDR_SIZE=SZ_2G,BOARD_TYPE_PREFIX=\"imx6q-\",BOARD_TYPE_POSTFIX=\"\""
# CONFIG_CMD_IMLS is not set
# CONFIG_CMD_FLASH is not set
CONFIG_SPI_FLASH=y
CONFIG_SYS_PROMPT="Q6 U-Boot> "
```

## configs/Q6dl_defconfig
```kconfig
CONFIG_ARM=y
CONFIG_ARCH_MX6=y
CONFIG_TARGET_Q6=y
CONFIG_SYS_EXTRA_OPTIONS="IMX_CONFIG=board/jci/Q6/Q6dl.cfg,MX6DL"
# CONFIG_CMD_IMLS is not set
# CONFIG_CMD_FLASH is not set
CONFIG_SPI_FLASH=y
```
